#include <SPI.h>
#include <Wire.h>
#include <Adafruit_GFX.h>
#include <Adafruit_SSD1306.h>
#define SCREEN_WIDTH 128 // OLED display width, in pixels
#define SCREEN_HEIGHT 64 // OLED display height, in pixels

// Declaration for an SSD1306 display connected to I2C (SDA, SCL pins)
Adafruit_SSD1306 display(SCREEN_WIDTH, SCREEN_HEIGHT, &Wire, -1);
signed short minutees=2, secondes=30;
char timeline[16];
int flg=0;
const int a=23,b=15,c=18,d=19;

// Bitmap of RickAstley Image
  const unsigned char RickAstley [] PROGMEM = {
  0xff, 0xff, 0xff, 0xff, 0xff, 0xff, 0xff, 0xff, 0xfe, 0x00, 0x03, 0xff, 0xff, 0xff, 0xff, 0xff, 
  0xff, 0xff, 0xff, 0xff, 0xff, 0xff, 0xff, 0xff, 0xfc, 0x00, 0x03, 0xff, 0xff, 0xff, 0xff, 0xff, 
  0xff, 0xff, 0xff, 0xff, 0xff, 0xff, 0xff, 0xff, 0xf8, 0x00, 0x01, 0xff, 0xff, 0xff, 0xff, 0xff, 
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  0xff, 0xff, 0xff, 0xff, 0xff, 0xff, 0xc0, 0x00, 0x00, 0x00, 0x00, 0x00, 0x00, 0x03, 0xff, 0xff
    
  };

void setup() {
  Serial.begin(115200);

  if(!display.begin(SSD1306_SWITCHCAPVCC, 0x3C)) { // Address 0x3D for 128x64
    Serial.println(F("SSD1306 allocation failed"));
    for(;;);
  }
	display.clearDisplay();

  pinMode(a,INPUT);
  pinMode(b,INPUT);
  pinMode(c,INPUT);
  pinMode(d,INPUT);
  
}

void loop() { 
  if(flg==0){
  display.clearDisplay();
  display.setTextSize(2);
  display.setTextColor(WHITE);
  display.setCursor(10, 0);
  display.println("Boom in:");
  display.println();

  sprintf(timeline,"%0.2d:%0.2d", minutees, secondes);
  display.setTextSize(3);
  display.setCursor(20,25)  ;
  display.println(timeline);
  display.display();
  Sequence_Check(); 
  delay(1000);
   secondes--;   

 if(minutees==0&&secondes==0)
  { while(true)
  {
    display.clearDisplay();
    display.drawBitmap(0, 0,  RickAstley, 128, 64, WHITE);
	  display.display();
   
  }
  }
  Sequence_Check(); 
  
  if (secondes == -1)
  {
    secondes = 59;
    minutees --;
  }
  }
  }
void Sequence_Check()
{ if(digitalRead(a)==LOW)
   {if(digitalRead(b)==LOW)
     {if(digitalRead(c)==LOW)
      {if(digitalRead(d)==LOW)
          {display.clearDisplay();
            display.setTextSize(2);
            display.setCursor(30,10);
           display.println("Bomb");
           display.setCursor(10,35);
           display.println("Defused");
           
           display.display();
           flg=1;
           
          }
        }
    
     }
   } 
  else if(digitalRead(b)==LOW)
    { display.clearDisplay();
      display.drawBitmap(0, 0,  RickAstley, 128, 64, WHITE);
	    display.display();
      flg=1;   
    }
  else if(digitalRead(c)==LOW)
    { display.clearDisplay();
      display.drawBitmap(0, 0,  RickAstley, 128, 64, WHITE);
	    display.display();
      flg=1;
    }  
   else if(digitalRead(d)==LOW)
    { display.clearDisplay();
      display.drawBitmap(0, 0,  RickAstley, 128, 64, WHITE);
	    display.display();
      flg=1;
    }                
  }


